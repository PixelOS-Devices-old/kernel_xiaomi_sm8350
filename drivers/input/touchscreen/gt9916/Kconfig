## drivers/input/touchscreen/gt9916/Kconfig
```kconfig
#
# Goodix touchscreen driver configuration
#
config TOUCHSCREEN_GOODIX_BRL_9916
	tristate "Goodix berlin touchscreen"
	default n
	help
	  Say Y here if you have a Goodix berlin series touch controller
	  to your system.
	  If build module, say M.
	  If unsure, say N.

config TOUCHSCREEN_QGKI_GOODIX
	default n
	bool "QGKI config"

config TOUCHSCREEN_GOODIX_BRL_9916_FOR_TAOYAO
	bool "Goodix berlin taoyao support"
	help
		Say Y to include OSS kernel changes for taoyao
```
